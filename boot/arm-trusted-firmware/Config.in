## configs/numaker_som_ma35d16aa1a_defconfig
```kconfig
BR2_aarch64=y
BR2_cortex_a35=y
BR2_WGET="wget --passive-ftp -nd -t 3 --no-check-certificate"
BR2_TOOLCHAIN_BUILDROOT_VENDOR="nuvoton"
BR2_TOOLCHAIN_BUILDROOT_GLIBC=y
BR2_TOOLCHAIN_BUILDROOT_CXX=y
BR2_PACKAGE_HOST_GDB=y
BR2_TARGET_GENERIC_GETTY_PORT="ttyS0"
BR2_ROOTFS_POST_BUILD_SCRIPT="board/nuvoton/ma35d1/post-build.sh"
BR2_ROOTFS_POST_IMAGE_SCRIPT="board/nuvoton/ma35d1/post-image.sh"
BR2_LINUX_KERNEL=y
BR2_LINUX_KERNEL_MA35D1=y
BR2_LINUX_KERNEL_MA35D1_5_10_VERSION=y
BR2_LINUX_KERNEL_DEFCONFIG="ma35d1"
BR2_LINUX_KERNEL_DTS_SUPPORT=y
BR2_LINUX_KERNEL_INTREE_DTS_NAME="nuvoton/ma35d1-som-1g"
BR2_LINUX_KERNEL_NEEDS_HOST_OPENSSL=y
BR2_PACKAGE_E2FSPROGS=y
BR2_PACKAGE_E2FSPROGS_RESIZE2FS=y
BR2_PACKAGE_PARTED=y
BR2_PACKAGE_OPENSSL=y
BR2_PACKAGE_TSLIB=y
BR2_PACKAGE_EXPAT=y
BR2_PACKAGE_LIBFFI=y
BR2_TARGET_ROOTFS_EXT2=y
BR2_TARGET_ROOTFS_EXT2_4=y
BR2_TARGET_ROOTFS_EXT2_SIZE="240M"
BR2_TARGET_ROOTFS_UBI=y
BR2_TARGET_ROOTFS_UBI_SUBSIZE=2048
BR2_TARGET_ROOTFS_UBIFS_LEBSIZE=0x1f000
BR2_TARGET_ROOTFS_UBIFS_MAXLEBCNT=2800
BR2_TARGET_ROOTFS_UBIFS_OPTS="-F"
BR2_TARGET_ARM_TRUSTED_FIRMWARE=y
TFA_MA35D1_PMIC_1=y
TFA_CPU800_CUSTOM_DDR=y
BR2_TARGET_ARM_TRUSTED_FIRMWARE_CUSTOM_DDR="MA35D16A087C_NonMCP_WBDDR3L_512M_2PCS.h"
TFA_CUSTOM_DDR_SIZE="0x40000000"
BR2_TARGET_ARM_TRUSTED_FIRMWARE_CUSTOM_TARBALL=y
BR2_TARGET_ARM_TRUSTED_FIRMWARE_CUSTOM_TARBALL_LOCATION="$(call github,OpenNuvoton,MA35D1_arm-trusted-firmware-v2.3,master)/MA35D1_arm-trusted-firmware-v2.3-master.tar.gz"
BR2_TARGET_ARM_TRUSTED_FIRMWARE_PLATFORM="ma35d1"
BR2_TARGET_ARM_TRUSTED_FIRMWARE_FIP=y
BR2_TARGET_ARM_TRUSTED_FIRMWARE_BL31=y
BR2_TARGET_ARM_TRUSTED_FIRMWARE_BL32_OPTEE=y
BR2_TARGET_ARM_TRUSTED_FIRMWARE_UBOOT_AS_BL33=y
BR2_TARGET_ARM_TRUSTED_FIRMWARE_NEEDS_DTC=y
BR2_TARGET_OPTEE_OS=y
BR2_TARGET_OPTEE_OS_MA35D1_TARBALL=y
BR2_TARGET_UBOOT=y
BR2_TARGET_UBOOT_BUILD_SYSTEM_KCONFIG=y
BR2_TARGET_UBOOT_CUSTOM_TARBALL=y
BR2_TARGET_UBOOT_CUSTOM_TARBALL_LOCATION="$(call github,OpenNuvoton,MA35D1_u-boot-v2020.07,master)/MA35D1_u-boot-v2020.07-master.tar.gz"
BR2_TARGET_UBOOT_BOARD_DEFCONFIG="ma35d1_sdcard0"
BR2_TARGET_UBOOT_NEEDS_DTC=y
BR2_PACKAGE_NUVOTON_MA35D1=y
BR2_PACKAGE_HOST_PYTHON3_NUWRITER=y
BR2_PACKAGE_HOST_M4_BSP=y
BR2_PACKAGE_HOST_DOSFSTOOLS=y
BR2_PACKAGE_HOST_ENVIRONMENT_SETUP=y
BR2_PACKAGE_HOST_GENIMAGE=y
BR2_PACKAGE_HOST_JQ=y
BR2_PACKAGE_HOST_MTOOLS=y
BR2_PACKAGE_HOST_PARTED=y
BR2_PACKAGE_HOST_PYTHON3=y
BR2_PACKAGE_HOST_PYTHON3_SSL=y
BR2_PACKAGE_HOST_UBOOT_TOOLS=y
BR2_PACKAGE_HOST_UBOOT_TOOLS_FIT_SUPPORT=y
BR2_PACKAGE_HOST_UBOOT_TOOLS_ENVIMAGE=y
BR2_PACKAGE_HOST_UBOOT_TOOLS_ENVIMAGE_SIZE="0x10000"
```

## configs/nuvoton_ma35d1_som_1gb_z_defconfig
```kconfig
BR2_aarch64=y
BR2_cortex_a35=y
BR2_WGET="wget --passive-ftp -nd -t 3 --no-check-certificate"
BR2_TOOLCHAIN_BUILDROOT_VENDOR="nuvoton"
BR2_TOOLCHAIN_BUILDROOT_GLIBC=y
BR2_PACKAGE_HOST_LINUX_HEADERS_CUSTOM_5_4=y
BR2_TOOLCHAIN_BUILDROOT_CXX=y
BR2_PACKAGE_HOST_GDB=y
BR2_TARGET_GENERIC_GETTY_PORT="ttyS0"
BR2_ROOTFS_POST_BUILD_SCRIPT="board/nuvoton/ma35d1/post-build.sh"
BR2_ROOTFS_POST_IMAGE_SCRIPT="board/nuvoton/ma35d1/post-image.sh"
BR2_LINUX_KERNEL=y
BR2_LINUX_KERNEL_CUSTOM_TARBALL=y
BR2_LINUX_KERNEL_CUSTOM_TARBALL_LOCATION="$(call github,OpenNuvoton,MA35D1_linux-5.4.y,master)/MA35D1_linux-5.4.y-master.tar.gz"
BR2_LINUX_KERNEL_DEFCONFIG="ma35d1"
BR2_LINUX_KERNEL_DTS_SUPPORT=y
BR2_LINUX_KERNEL_INTREE_DTS_NAME="nuvoton/ma35d1-som-1gb"
BR2_LINUX_KERNEL_NEEDS_HOST_OPENSSL=y
BR2_PACKAGE_E2FSPROGS=y
BR2_PACKAGE_E2FSPROGS_RESIZE2FS=y
BR2_PACKAGE_OPENSSL=y
BR2_PACKAGE_EXPAT=y
BR2_PACKAGE_LIBFFI=y
BR2_TARGET_ROOTFS_EXT2=y
BR2_TARGET_ROOTFS_EXT2_4=y
BR2_TARGET_ROOTFS_EXT2_SIZE="240M"
BR2_TARGET_ROOTFS_UBI=y
BR2_TARGET_ROOTFS_UBI_SUBSIZE=2048
BR2_TARGET_ROOTFS_UBIFS_LEBSIZE=0x1f000
BR2_TARGET_ROOTFS_UBIFS_MAXLEBCNT=800
BR2_TARGET_ROOTFS_UBIFS_OPTS="-F"
BR2_TARGET_ARM_TRUSTED_FIRMWARE=y
BR2_TARGET_ARM_TRUSTED_FIRMWARE_INTREE_DTS_NAME="ma35d1xx0-zentel-1gb"
BR2_TARGET_ARM_TRUSTED_FIRMWARE_CUSTOM_TARBALL=y
BR2_TARGET_ARM_TRUSTED_FIRMWARE_CUSTOM_TARBALL_LOCATION="$(call github,OpenNuvoton,MA35D1_arm-trusted-firmware-v2.3,master)/MA35D1_arm-trusted-firmware-v2.3-master.tar.gz"
BR2_TARGET_ARM_TRUSTED_FIRMWARE_PLATFORM="ma35d1"
BR2_TARGET_ARM_TRUSTED_FIRMWARE_FIP=y
BR2_TARGET_ARM_TRUSTED_FIRMWARE_BL31=y
BR2_TARGET_ARM_TRUSTED_FIRMWARE_UBOOT_AS_BL33=y
BR2_TARGET_ARM_TRUSTED_FIRMWARE_ADDITIONAL_VARIABLES="MA35D1_DRAM_SIZE=0x3F800000 MA35D1_DDR_MAX_SIZE=0x40000000 MA35D1_DRAM_S_BASE=0xAF800000 MA35D1_BL32_BASE=0xAF800000"
BR2_TARGET_ARM_TRUSTED_FIRMWARE_NEEDS_DTC=y
BR2_TARGET_UBOOT=y
BR2_TARGET_UBOOT_BUILD_SYSTEM_KCONFIG=y
BR2_TARGET_UBOOT_CUSTOM_TARBALL=y
BR2_TARGET_UBOOT_CUSTOM_TARBALL_LOCATION="$(call github,OpenNuvoton,MA35D1_u-boot-v2020.07,master)/MA35D1_u-boot-v2020.07-master.tar.gz"
BR2_TARGET_UBOOT_BOARD_DEFCONFIG="ma35d1_sdcard0"
BR2_TARGET_UBOOT_NEEDS_DTC=y
BR2_PACKAGE_NUVOTON_MA35D1=y
BR2_PACKAGE_HOST_PYTHON3_NUWRITER=y
BR2_PACKAGE_HOST_M4_BSP=y
BR2_PACKAGE_HOST_DOSFSTOOLS=y
BR2_PACKAGE_HOST_ENVIRONMENT_SETUP=y
BR2_PACKAGE_HOST_GENIMAGE=y
BR2_PACKAGE_HOST_JQ=y
BR2_PACKAGE_HOST_MTOOLS=y
BR2_PACKAGE_HOST_PARTED=y
BR2_PACKAGE_HOST_PYTHON3=y
BR2_PACKAGE_HOST_PYTHON3_SSL=y
BR2_PACKAGE_HOST_UBOOT_TOOLS=y
BR2_PACKAGE_HOST_UBOOT_TOOLS_FIT_SUPPORT=y
BR2_PACKAGE_HOST_UBOOT_TOOLS_ENVIMAGE=y
BR2_PACKAGE_HOST_UBOOT_TOOLS_ENVIMAGE_SIZE="0x10000"
```

## configs/nuvoton_nuc972_defconfig
```kconfig
BR2_NUVOTON_NUC9X0=y
BR2_arm=y
BR2_SVN="svn"
BR2_TOOLCHAIN_BUILDROOT_VENDOR="nuvoton"
BR2_PACKAGE_HOST_LINUX_HEADERS_CUSTOM_5_10=y
BR2_TOOLCHAIN_BUILDROOT_LOCALE=y
BR2_TOOLCHAIN_BUILDROOT_CXX=y
BR2_PACKAGE_HOST_GDB=y
BR2_ROOTFS_DEVICE_CREATION_DYNAMIC_MDEV=y
BR2_TARGET_GENERIC_GETTY_BAUDRATE_115200=y
BR2_LINUX_KERNEL=y
BR2_LINUX_KERNEL_CUSTOM_TARBALL=y
BR2_LINUX_KERNEL_CUSTOM_TARBALL_LOCATION="$(call github,OpenNuvoton,NUC970-linux-5.10.y,master)/NUC970-linux-5.10.y-master.tar.gz"
BR2_LINUX_KERNEL_DEFCONFIG="nuc972"
BR2_LINUX_KERNEL_UIMAGE=y
BR2_PACKAGE_APPLICATIONS=y
NUC970_APPLICATIONS=y
APPLICATIONS_BUILD_DEMOS=y
BR2_PACKAGE_ALSA_UTILS=y
BR2_PACKAGE_BZIP2=y
BR2_PACKAGE_ZIP=y
BR2_PACKAGE_GETTEXT=y
BR2_PACKAGE_ZLIB=y
BR2_TARGET_ROOTFS_INITRAMFS=y
BR2_TARGET_UBOOT=y
BR2_TARGET_UBOOT_BUILD_SYSTEM_KCONFIG=y
BR2_TARGET_UBOOT_CUSTOM_TARBALL=y
BR2_TARGET_UBOOT_CUSTOM_TARBALL_LOCATION="$(call github,OpenNuvoton,NUC970_U-Boot_v2016.11,master)/NUC970_U-Boot_v2016.11-master.tar.gz"
BR2_TARGET_UBOOT_BOARD_DEFCONFIG="nuc970"
BR2_TARGET_UBOOT_SPL=y
BR2_PACKAGE_HOST_ENVIRONMENT_SETUP=y
```

## configs/nuvoton_nuc980_chili_defconfig
```kconfig
BR2_arm=y
BR2_SVN="svn"
BR2_SHARED_STATIC_LIBS=y
BR2_TOOLCHAIN_BUILDROOT_VENDOR="nuvoton"
BR2_TOOLCHAIN_BUILDROOT_LOCALE=y
BR2_TOOLCHAIN_BUILDROOT_CXX=y
BR2_PACKAGE_HOST_GDB=y
BR2_ROOTFS_DEVICE_CREATION_DYNAMIC_MDEV=y
BR2_TARGET_GENERIC_GETTY_BAUDRATE_115200=y
BR2_ROOTFS_POST_BUILD_SCRIPT="board/nuvoton/nuc9x0/install_rootfs_chili.sh"
BR2_LINUX_KERNEL=y
BR2_LINUX_KERNEL_CUSTOM_TARBALL=y
BR2_LINUX_KERNEL_CUSTOM_TARBALL_LOCATION="$(call github,OpenNuvoton,NUC980-linux-5.10.y,master)/NUC980-linux-5.10.y-master.tar.gz"
BR2_LINUX_KERNEL_DEFCONFIG="nuc980"
BR2_LINUX_KERNEL_UIMAGE=y
BR2_PACKAGE_APPLICATIONS=y
NUC980_APPLICATIONS=y
NUC980_APPLICATIONS_BUILD_DEMOS=y
NUC980_APPLICATIONS_BUILD_YAFFS2UTILS=y
BR2_PACKAGE_ALSA_UTILS=y
BR2_PACKAGE_BZIP2=y
BR2_PACKAGE_ZIP=y
BR2_PACKAGE_GETTEXT=y
BR2_PACKAGE_FSWEBCAM=y
BR2_PACKAGE_LINUX_FIRMWARE=y
BR2_PACKAGE_LINUX_FIRMWARE_RTL_81XX=y
BR2_PACKAGE_LIGHTTPD=y
BR2_PACKAGE_PPPD=y
BR2_PACKAGE_WPA_SUPPLICANT=y
BR2_PACKAGE_WPA_SUPPLICANT_CLI=y
BR2_TARGET_ROOTFS_INITRAMFS=y
BR2_TARGET_UBOOT=y
BR2_TARGET_UBOOT_BUILD_SYSTEM_KCONFIG=y
BR2_TARGET_UBOOT_CUSTOM_TARBALL=y
BR2_TARGET_UBOOT_CUSTOM_TARBALL_LOCATION="$(call github,OpenNuvoton,NUC970_U-Boot_v2016.11,master)/NUC970_U-Boot_v2016.11-master.tar.gz"
BR2_TARGET_UBOOT_BOARD_DEFCONFIG="nuc980_chili"
```
