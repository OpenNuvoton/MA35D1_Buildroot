## package/applications/Config.in
```kconfig
config BR2_PACKAGE_APPLICATIONS
	bool "Applications"
	help
	  Enable this option if you want to build a application for
	  your embedded device

if BR2_PACKAGE_APPLICATIONS

config NUC970_APPLICATIONS
	bool "NUC970 Applications"
	help
	  Enable this option if you want to build a nuc970 application for
	  your embedded device

if NUC970_APPLICATIONS

config APPLICATIONS_BUILD_DEMOS
	bool "Demos"
	  
config APPLICATIONS_BUILD_EMWIN
	bool "EmWin"

config APPLICATIONS_BUILD_YAFFS2UTILS
        bool "Yaffs2utils"

config APPLICATIONS_BUILD_MINIGUI
        bool "Minigui"

endif # BR2_PACKAGE_APPLICATIONS

config NUC980_APPLICATIONS
        bool "NUC980 Applications"
        help
          Enable this option if you want to build a nuc980 application for
          your embedded device

if NUC980_APPLICATIONS

config NUC980_APPLICATIONS_BUILD_DEMOS
        bool "Demos"

config NUC980_APPLICATIONS_BUILD_YAFFS2UTILS
        bool "Yaffs2utils"

endif #BR2_PACKAGE_NUC980_APPLICATIONS

endif
```

## package/dotnet-runtime/Config.in
```kconfig
comment "dotnet-runtime needs a toolchain w/ glibc and threads"
        depends on !BR2_TOOLCHAIN_USES_GLIBC

config BR2_PACKAGE_DOTNET_RUNTIME
    bool "dotnet-runtime"
    depends on BR2_TOOLCHAIN_USES_GLIBC
    depends on BR2_TOOLCHAIN_HAS_THREADS
    select BR2_PACKAGE_LIBZLIB
    select BR2_PACKAGE_OPENSSL
    select BR2_PACKAGE_ICU
    select BR2_PACKAGE_LIBCURL
    help
      .NET Core 3.1 Runtime (v3.1.26) - Linux ARM64 binaries
      https://dotnet.microsoft.com/download/dotnet-core/3.1
```

## package/nuvoton-ma35d1/Config.in.host
```kconfig
menuconfig BR2_PACKAGE_NUVOTON_MA35D1
	bool "host nuvoton-ma35d1 libraries"
	depends on BR2_arm || BR2_aarch64
	help
	  Those packages provide some hardware tools for Nutoton 
	  MA35D1 platforms.

if BR2_PACKAGE_NUVOTON_MA35D1
source "package/nuvoton-ma35d1/python3-nuwriter/Config.in.host"
source "package/nuvoton-ma35d1/m4-bsp/Config.in.host"
source "package/nuvoton-ma35d1/gcc-arm-none-eabi/Config.in.host"
source "package/nuvoton-ma35d1/nu-eclipse/Config.in.host"
endif
```

## package/nuvoton-ma35d1/gcc-arm-none-eabi/Config.in.host
```kconfig
config BR2_PACKAGE_HOST_GCC_ARM_NONE_EABI
	bool "host gcc-arm-none-eabi"
	help
	  GCC for Cortex-M4 
```

## package/nuvoton-ma35d1/m4-bsp/Config.in.host
```kconfig
config BR2_PACKAGE_HOST_M4_BSP
	bool "host RTP-BSP"
	select BR2_PACKAGE_HOST_GCC_ARM_NONE_EABI
	select BR2_PACKAGE_HOST_NU_ECLIPSE
	help
	  Real Time Processor(RTP) BSP
```

## package/nuvoton-ma35d1/python3-nuwriter/Config.in.host
```kconfig
config BR2_PACKAGE_HOST_PYTHON3_NUWRITER
	bool "host ma35d1-nuwriter"
	depends on BR2_PACKAGE_HOST_PYTHON3
	help
	  nuwriter tool
```

## package/nuvoton-ma35xx/Config.in.host
```kconfig
menuconfig BR2_PACKAGE_NUVOTON_MA35
	bool "host nuvoton-ma35xx libraries"
	depends on BR2_arm || BR2_aarch64
	help
	  Those packages provide some hardware tools for Nutoton 
	  MA35D1 platforms.

if BR2_PACKAGE_NUVOTON_MA35 && BR2_NUVOTON_MA35D1
source "package/nuvoton-ma35xx/m4-bsp/Config.in.host"
source "package/nuvoton-ma35xx/gcc-arm-none-eabi/Config.in.host"
source "package/nuvoton-ma35xx/nu-eclipse/Config.in.host"
endif
```

## package/nuvoton-ma35xx/nu-eclipse/Config.in.host
```kconfig
config BR2_PACKAGE_HOST_NU_ECLIPSE
	bool "host nu-eclipse"
	help
	  nuvoton eclipse IDE
```

## package/python3-nuwriter/Config.in.host
```kconfig
config BR2_PACKAGE_HOST_PYTHON3_NUWRITER
	bool
	depends on BR2_PACKAGE_HOST_PYTHON3
	default "y" if BR2_HOST_NVT=y
	help
	  nuwriter tool
```
