## boot/arm-trusted-firmware/Config.in
```kconfig
config BR2_TARGET_ARM_TRUSTED_FIRMWARE
	bool "ARM Trusted Firmware (ATF)"
	depends on (BR2_ARM_CPU_ARMV8A || BR2_ARM_CPU_ARMV7A) && \
		   BR2_TARGET_UBOOT
	help
	  Enable this option if you want to build the ATF for your ARM
	  based embedded device.

	  https://github.com/ARM-software/arm-trusted-firmware

if BR2_TARGET_ARM_TRUSTED_FIRMWARE

config BR2_TARGET_ARM_TRUSTED_FIRMWARE_LOAD_SCP_BL2
        bool "Add SCP BL2 image into FIP Image"
        help
          Add SCP_BL2 image into FIP Image

if BR2_TARGET_ARM_TRUSTED_FIRMWARE_LOAD_SCP_BL2

choice
	prompt "Load Image into FIP Image"
config BR2_TARGET_ARM_TRUSTED_FIRMWARE_LOAD_M4
	bool "RTP M4 Image"
	depends on BR2_TARGET_ARM_TRUSTED_FIRMWARE_LOAD_SCP_BL2
	help
          Add RTP m4 binary file into FIP Image

config BR2_TARGET_ARM_TRUSTED_FIRMWARE_LOAD_A35
        bool "A35 image"
        depends on BR2_TARGET_ARM_TRUSTED_FIRMWARE_LOAD_SCP_BL2
        help
          Add A35 binary file into FIP Image

endchoice

if BR2_TARGET_ARM_TRUSTED_FIRMWARE_LOAD_A35

config BR2_TARGET_ARM_TRUSTED_FIRMWARE_LOAD_A35_WITH_IPI
	bool "IPI support"
	depends on BR2_TARGET_ARM_TRUSTED_FIRMWARE_LOAD_SCP_BL2
	help
	  This helps enable Ips for IPI.
endif

config BR2_TARGET_ARM_TRUSTED_FIRMWARE_SCP_URL
	string "SCP_BL2 binary file names"
	default "RTP-BSP/Template.bin" if BR2_TARGET_ARM_TRUSTED_FIRMWARE_LOAD_M4
	default "AMP_Core1RTOS.bin" if BR2_TARGET_ARM_TRUSTED_FIRMWARE_LOAD_A35_WITH_IPI
	default "AmpCore1.bin" if BR2_TARGET_ARM_TRUSTED_FIRMWARE_LOAD_A35
	help
	  Name of binary file.
endif

if BR2_TARGET_ARM_TRUSTED_FIRMWARE_LOAD_A35

config BR2_TARGET_ARM_TRUSTED_FIRMWARE_LOAD_A35_BASE
        string "The execution address of CORE1"
        default "0x88000000"

config BR2_TARGET_ARM_TRUSTED_FIRMWARE_LOAD_A35_LEN
        string "The execution size of CORE1"
        default "0x2000000"

endif

if BR2_NUVOTON_MA35D1

choice
        prompt "MA35D1 PMIC Select"
config TFA_MA35D1_PMIC_0
        bool "No PMIC"
config TFA_MA35D1_PMIC_1
        bool "DIALOG PMIC"
config TFA_MA35D1_PMIC_2
        bool "IP6103 PMIC"
config TFA_MA35D1_PMIC_3
        bool "APW7704F PMIC"
endchoice

if !TFA_MA35D1_PMIC_0
config TFA_MA35D1_CPU_CORE_POWER
        int "MA35D1 CPU Core Power"
        default 125
        help
          The cpu core power voltage
          decimal integer value.
          125 = 1.25V, 120 = 1.20V,
          1xx = 1.xxV, etc.
endif

choice
        prompt "In-tree Device Tree Source file names"
config TFA_CPU800_WB128M
        bool "ma35d1-cpu800-wb-128m"
config TFA_CPU800_WB256M
        bool "ma35d1-cpu800-wb-256m"
config TFA_CPU800_WB512M
        bool "ma35d1-cpu800-wb-512m"
config TFA_CPU800_WB1G
        bool "ma35d1-cpu800-wb-1g"
config TFA_CPU800_WB2G
        bool "ma35d1-cpu800-wb-2g"
config TFA_CPU1G_WB256M
        bool "ma35d1-cpu1g-wb-256m"
config TFA_CPU1G_WB512M
        bool "ma35d1-cpu1g-wb-512m"
config TFA_CPU1G_WB1G
        bool "ma35d1-cpu1g-wb-1g"
config TFA_CPU1G_WB2G
        bool "ma35d1-cpu1g-wb-2g"
config TFA_CPU800_MC1G
        bool "ma35d1-cpu800-mc-1g"
config TFA_CPU1G_MC1G
        bool "ma35d1-cpu1g-mc-1g"
config TFA_CPU800_CUSTOM_DDR
        bool "ma35d1-cpu800-custom-ddr"
config TFA_CPU1G_CUSTOM_DDR
        bool "ma35d1-cpu1g-custom-ddr"
endchoice

config BR2_TARGET_ARM_TRUSTED_FIRMWARE_INTREE_DTS_NAME
	string
	default "ma35d1-cpu800-wb-128m" if TFA_CPU800_WB128M
	default "ma35d1-cpu800-wb-256m" if TFA_CPU800_WB256M
	default "ma35d1-cpu800-wb-512m" if TFA_CPU800_WB512M
	default "ma35d1-cpu1g-wb-256m" if TFA_CPU1G_WB256M
	default "ma35d1-cpu1g-wb-512m" if TFA_CPU1G_WB512M
	default "ma35d1-cpu800-mc-1g" if TFA_CPU800_MC1G
	default "ma35d1-cpu1g-mc-1g" if TFA_CPU1G_MC1G
	default "ma35d1-cpu800-custom-ddr" if TFA_CPU800_CUSTOM_DDR
        default "ma35d1-cpu1g-custom-ddr" if TFA_CPU1G_CUSTOM_DDR
	help
	  Name of in-tree device tree source file, without
	  the trailing .dts. You can provide a list of
	  dts files to build, separated by spaces.

	  The currently provided device tree of TF-A are as follows:
		- ma35d1-cpu800-wb-128m
		- ma35d1-cpu800-wb-256m
		- ma35d1-cpu800-wb-512m
		- ma35d1-cpu1g-wb-256m
		- ma35d1-cpu1g-wb-512m

		- ma35d1-cpu800-mc-1g
		- ma35d1-cpu1g-mc-1g
		- ma35d1-cpu800-custom-ddr
		- ma35d1-cpu1g-custom-ddr

if (TFA_CPU800_CUSTOM_DDR || TFA_CPU1G_CUSTOM_DDR)
config BR2_TARGET_ARM_TRUSTED_FIRMWARE_CUSTOM_DDR
	string "Custom DDR header file in board/nuvoton/ma35d1/ddr"
	default "custom_ddr.h"

config TFA_CUSTOM_DDR_SIZE
	string "Custom DDR size"
	default "0x10000000"
endif

endif

if BR2_NUVOTON_MA35D0

choice
        prompt "MA35D0 PMIC Select"
config TFA_MA35D0_PMIC_0
        bool "No PMIC"
config TFA_MA35D0_PMIC_1
        bool "DIALOG PMIC"
config TFA_MA35D0_PMIC_2
        bool "IP6103 PMIC"
config TFA_MA35D0_PMIC_3
        bool "APW7704F PMIC"
endchoice

choice
	prompt "In-tree Device Tree Source file names"
config TFA_MA35D0_CPU650_CUSTOM_DDR
	bool "ma35d0-cpu650-custom-ddr"
endchoice

config BR2_TARGET_ARM_TRUSTED_FIRMWARE_INTREE_DTS_NAME
	string
	default "ma35d0-cpu650-custom-ddr" if TFA_MA35D0_CPU650_CUSTOM_DDR
	help
	  Name of in-tree device tree source file, without
	  the trailing .dts. You can provide a list of
	  dts files to build, separated by spaces.

	  The currently provided device tree of TF-A are as follows:
		- ma35d0-cpu650-custom-ddr

if (TFA_MA35D0_CPU650_CUSTOM_DDR)
config BR2_TARGET_ARM_TRUSTED_FIRMWARE_CUSTOM_DDR
	string "Custom DDR header file in board/nuvoton/ma35d0/ddr"
	default "custom_ddr.h"

config TFA_CUSTOM_DDR_SIZE
	string "Custom DDR size"
	default "0x10000000"
endif

endif

if BR2_NUVOTON_MA35H0

choice
        prompt "MA35H0 PMIC Select"
config TFA_MA35H0_PMIC_0
        bool "No PMIC"
config TFA_MA35H0_PMIC_1
        bool "DIALOG PMIC"
config TFA_MA35H0_PMIC_2
        bool "IP6103 PMIC"
config TFA_MA35H0_PMIC_3
        bool "APW7704F PMIC"
endchoice

choice
        prompt "In-tree Device Tree Source file names"
config TFA_MA35H0_CPU650_CUSTOM_DDR
        bool "ma35h0-cpu650-custom-ddr"
endchoice

config BR2_TARGET_ARM_TRUSTED_FIRMWARE_INTREE_DTS_NAME
	string
	default "ma35h0-cpu650-custom-ddr" if TFA_MA35H0_CPU650_CUSTOM_DDR
	help
	  Name of in-tree device tree source file, without
	  the trailing .dts. You can provide a list of
	  dts files to build, separated by spaces.

	  The currently provided device tree of TF-A are as follows:
		- ma35h0-cpu650-custom-ddr

if (TFA_MA35H0_CPU650_CUSTOM_DDR)
config BR2_TARGET_ARM_TRUSTED_FIRMWARE_CUSTOM_DDR
	string "Custom DDR header file in board/nuvoton/ma35h0/ddr"
	default "custom_ddr.h"

config TFA_CUSTOM_DDR_SIZE
	string "Custom DDR size"
	default "0x10000000"
endif

endif

choice
	prompt "ATF Version"
	help
	  Select the specific ATF version you want to use

config BR2_TARGET_ARM_TRUSTED_FIRMWARE_LATEST_VERSION
	bool "v2.4"

config BR2_TARGET_ARM_TRUSTED_FIRMWARE_CUSTOM_VERSION
	bool "Custom version"
	help
	  This option allows to use a specific official versions

config BR2_TARGET_ARM_TRUSTED_FIRMWARE_CUSTOM_TARBALL
	bool "Custom tarball"

config BR2_TARGET_ARM_TRUSTED_FIRMWARE_CUSTOM_GIT
	bool "Custom Git repository"

endchoice

if BR2_TARGET_ARM_TRUSTED_FIRMWARE_CUSTOM_TARBALL

config BR2_TARGET_ARM_TRUSTED_FIRMWARE_CUSTOM_TARBALL_LOCATION
	string "URL of custom ATF tarball"

endif

config BR2_TARGET_ARM_TRUSTED_FIRMWARE_CUSTOM_VERSION_VALUE
	string "ATF version"
	depends on BR2_TARGET_ARM_TRUSTED_FIRMWARE_CUSTOM_VERSION

config BR2_TARGET_ARM_TRUSTED_FIRMWARE_VERSION
	string
	default "v2.4"		if BR2_TARGET_ARM_TRUSTED_FIRMWARE_LATEST_VERSION
	default "custom"	if BR2_TARGET_ARM_TRUSTED_FIRMWARE_CUSTOM_TARBALL
	default BR2_TARGET_ARM_TRUSTED_FIRMWARE_CUSTOM_REPO_VERSION \
				if BR2_TARGET_ARM_TRUSTED_FIRMWARE_CUSTOM_GIT
	default BR2_TARGET_ARM_TRUSTED_FIRMWARE_CUSTOM_VERSION_VALUE \
				if BR2_TARGET_ARM_TRUSTED_FIRMWARE_CUSTOM_VERSION

if BR2_TARGET_ARM_TRUSTED_FIRMWARE_CUSTOM_GIT

config BR2_TARGET_ARM_TRUSTED_FIRMWARE_CUSTOM_REPO_URL
	string "URL of custom repository"

config BR2_TARGET_ARM_TRUSTED_FIRMWARE_CUSTOM_REPO_VERSION
	string "Custom repository version"
	help
	  Revision to use in the typical format used by Git
	  E.G. a sha id, a tag, ..

endif

config BR2_TARGET_ARM_TRUSTED_FIRMWARE_PLATFORM
	string "ATF platform"
	help
	  Target plaform to build for.

config BR2_TARGET_ARM_TRUSTED_FIRMWARE_FIP
	bool "Build FIP image"
	help
	  This option enables building the FIP image (Firmware Image
	  Package). This is typically the image format used by
	  platforms were ATF encapsulates the second stage bootloader
	  (such as U-Boot).

config BR2_TARGET_ARM_TRUSTED_FIRMWARE_BL31
	bool "Build BL31 image"
	help
	  This option enables building the BL31 image. This is
	  typically used on platforms where another bootloader (e.g
	  U-Boot) encapsulates ATF BL31.

config BR2_TARGET_ARM_TRUSTED_FIRMWARE_BL31_UBOOT
	bool "Build BL31 U-Boot image"
	select BR2_TARGET_ARM_TRUSTED_FIRMWARE_BL31
	help
	  Generates a U-Boot image named atf-uboot.ub containing
	  bl31.bin.  This is used for example by the Xilinx version of
	  U-Boot SPL to load ATF on the ZynqMP SoC.

choice
	prompt "BL32"
	default BR2_TARGET_ARM_TRUSTED_FIRMWARE_BL32_DEFAULT
	help
	  Select BL32 stage for the trusted firmware

config BR2_TARGET_ARM_TRUSTED_FIRMWARE_BL32_DEFAULT
	bool "Default"
	help
	  With this option selected, ATF will not use any BL32 stage,
	  unless if one is explicitly chosen using the SPD (for
	  AArch64) or AARCH32_SP (for AArch32) variables, which can be
	  passed through
	  BR2_TARGET_ARM_TRUSTED_FIRMWARE_ADDITIONAL_VARIABLES.

config BR2_TARGET_ARM_TRUSTED_FIRMWARE_BL32_OPTEE
	bool "OP-TEE OS"
	depends on BR2_TARGET_OPTEE_OS
	help
	  This option allows to embed OP-TEE OS as the BL32 part of
	  the ARM Trusted Firmware boot sequence.

endchoice

config BR2_TARGET_ARM_TRUSTED_FIRMWARE_UBOOT_AS_BL33
	bool "Use U-Boot as BL33"
	depends on BR2_TARGET_UBOOT
	help
	  This option allows to embed u-boot.bin as the BL33 part of
	  the ARM Trusted Firmware. It ensures that the u-boot package
	  gets built before ATF, and that the appropriate BL33
	  variable pointing to u-boot.bin is passed when building ATF.

if BR2_TARGET_ARM_TRUSTED_FIRMWARE_UBOOT_AS_BL33

config BR2_TARGET_ARM_TRUSTED_FIRMWARE_UBOOT_BL33_IMAGE
	string "U-Boot BL33 image name"
	default "u-boot.bin"
	help
	  Name of the U-Boot BL33 image to include in ATF, it must
	  have been installed to BINARIES_DIR by the U-Boot package.

endif

config BR2_TARGET_ARM_TRUSTED_FIRMWARE_ADDITIONAL_TARGETS
	string "Additional ATF make targets"
	help
	  Additional targets for the ATF build
	  E.G. When using the QorIQ custom ATF repository from NXP,
	  the target 'pbl' can be used to build the pbl binary.

config BR2_TARGET_ARM_TRUSTED_FIRMWARE_ADDITIONAL_VARIABLES
	string "Additional ATF build variables"
	help
	  Additional parameters for the ATF build
	  E.G. 'DEBUG=1 LOG_LEVEL=20'

config BR2_TARGET_ARM_TRUSTED_FIRMWARE_DEBUG
	bool "Build in debug mode"
	help
	  Enable this option to build ATF with DEBUG=1.

config BR2_TARGET_ARM_TRUSTED_FIRMWARE_IMAGES
	string "Binary boot images"
	default "*.bin"
	help
	  Names of generated image files that are installed in the
	  output images/ directory.

config BR2_TARGET_ARM_TRUSTED_FIRMWARE_NEEDS_DTC
	bool "Needs dtc"
	select BR2_PACKAGE_HOST_DTC
	help
	  Select this option if your ATF board configuration
	  requires the Device Tree compiler to be available.

config BR2_TARGET_ARM_TRUSTED_FIRMWARE_NEEDS_ARM32_TOOLCHAIN
	bool "Needs arm-none-eabi toolchain"
	depends on BR2_aarch64
	depends on BR2_HOSTARCH = "x86_64"
	help
	  Select this option if your ATF board configuration requires
	  an ARM32 bare metal toolchain to be available.

config BR2_TARGET_ARM_TRUSTED_FIRMWARE_SSP
	bool "Build with SSP"
	default y
	depends on BR2_TOOLCHAIN_HAS_SSP
	depends on !BR2_SSP_NONE
	help
	  Say 'y' here if you want to build ATF with SSP.

	  Your board must have SSP support in ATF: it must have an
	  implementation for plat_get_stack_protector_canary().

	  If you say 'y', the SSP level will be the level selected
	  by the global SSP setting.

config BR2_TARGET_ARM_TRUSTED_FIRMWARE_SSP_LEVEL
	string
	# While newer versions of TF-A support "none" as
	# ENABLE_STACK_PROTECTOR value, older versions (e.g 2.0) only
	# supported "0" to disable SSP.
	default "0"    	  if !BR2_TARGET_ARM_TRUSTED_FIRMWARE_SSP
	default "default" if BR2_SSP_REGULAR
	default "strong"  if BR2_SSP_STRONG
	default "all"     if BR2_SSP_ALL

endif
```

## boot/ma35d1-secureboot/Config.in
```kconfig
if	BR2_NUVOTON_MA35D1
config BR2_TARGET_MA35D1_BOOT_SPACE
        int "MA35D1 Boot Space(KiB)"
	default "32768"
        help
          Reserved space form MMC/SD 

config BR2_TARGET_MA35D1_SECURE_BOOT
	bool "MA35D1 Secure Boot"
	help
	  MA35D1 Secure Boot is a first level bootloader for the MA35D1
	  devices.

if	BR2_TARGET_MA35D1_SECURE_BOOT

config BR2_TARGET_MA35D1_AES_KEY
	string "AES Key"
	default "0A0BC81E5AFBF836C5E0CFBEA12C1E269A2EBC3B0B6EC39EEE1C7142F760EBC4"
	help
	  AES Key

config BR2_TARGET_MA35D1_ECDSA_KEY
	string "ECDSA Key"
	default "8F1571E9975006A545DF854264F7B18934B5CB2EE619E66DBC0FBEA52C71C919"
	help
          ECDSA Key
endif
endif

if	BR2_NUVOTON_MA35D0
config BR2_TARGET_MA35D0_BOOT_SPACE
        int "MA35D0 Boot Space(KiB)"
	default "32768"
        help
          Reserved space form MMC/SD 

config BR2_TARGET_MA35D0_SECURE_BOOT
	bool "MA35D0 Secure Boot"
	help
	  MA35D0 Secure Boot is a first level bootloader for the MA35D1
	  devices.

if	BR2_TARGET_MA35D0_SECURE_BOOT

config BR2_TARGET_MA35D0_AES_KEY
	string "AES Key"
	default "0A0BC81E5AFBF836C5E0CFBEA12C1E269A2EBC3B0B6EC39EEE1C7142F760EBC4"
	help
	  AES Key

config BR2_TARGET_MA35D0_ECDSA_KEY
	string "ECDSA Key"
	default "8F1571E9975006A545DF854264F7B18934B5CB2EE619E66DBC0FBEA52C71C919"
	help
          ECDSA Key
endif
endif

if	BR2_NUVOTON_MA35H0
config BR2_TARGET_MA35H0_BOOT_SPACE
        int "MA35H0 Boot Space(KiB)"
	default "32768"
        help
          Reserved space form MMC/SD 

config BR2_TARGET_MA35H0_SECURE_BOOT
	bool "MA35H0 Secure Boot"
	help
	  MA35H0 Secure Boot is a first level bootloader for the MA35D1
	  devices.

if	BR2_TARGET_MA35H0_SECURE_BOOT

config BR2_TARGET_MA35H0_AES_KEY
	string "AES Key"
	default "0A0BC81E5AFBF836C5E0CFBEA12C1E269A2EBC3B0B6EC39EEE1C7142F760EBC4"
	help
	  AES Key

config BR2_TARGET_MA35H0_ECDSA_KEY
	string "ECDSA Key"
	default "8F1571E9975006A545DF854264F7B18934B5CB2EE619E66DBC0FBEA52C71C919"
	help
          ECDSA Key
endif
endif
```
